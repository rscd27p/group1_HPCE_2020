## project_1/Custom Meta-layer/meta-tec/conf/layer.conf
```bitbake
# We have a conf and classes directory, add to BBPATH
BBPATH .= ":${LAYERDIR}"

# We have recipes-* directories, add to BBFILES
BBFILES += "${LAYERDIR}/recipes-*/*/*.bb \
	${LAYERDIR}/recipes-*/*/*.bbappend"

BBFILE_COLLECTIONS += "tec"
BBFILE_PATTERN_tec = "^${LAYERDIR}/"
BBFILE_PRIORITY_tec   = "6"
```

## project_2/Custom_Meta-layer/meta-hpec/conf/layer.conf
```bitbake
# We have a conf and classes directory, add to BBPATH
BBPATH .= ":${LAYERDIR}"

# We have recipes-* directories, add to BBFILES
BBFILES += "${LAYERDIR}/recipes-*/*/*.bb \
	${LAYERDIR}/recipes-*/*/*.bbappend"

BBFILE_COLLECTIONS += "hpec"
BBFILE_PATTERN_hpec = "^${LAYERDIR}/"
BBFILE_PRIORITY_hpec = "6"

LAYERSERIES_COMPAT_parallel = "zeus"
```
